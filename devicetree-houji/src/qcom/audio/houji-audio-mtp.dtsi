#include "xiaomi-sm8650-common.dtsi"

&pineapple_snd {
	qcom,audio-routing = 
		"AMIC1", "Analog Mic1",
		"AMIC1", "MIC BIAS1",
		"AMIC2", "Analog Mic2",
		"AMIC2", "MIC BIAS2",
		"AMIC3", "Analog Mic3",
		"AMIC3", "MIC BIAS4",
		"AMIC4", "Analog Mic4",
		"AMIC4", "MIC BIAS4",
		"AMIC5", "Analog Mic5",
		"AMIC5", "MIC BIAS3",
		"VA AMIC1", "Analog Mic1",
		"VA AMIC1", "VA MIC BIAS1",
		"VA AMIC2", "Analog Mic2",
		"VA AMIC2", "VA MIC BIAS2",
		"VA AMIC3", "Analog Mic3",
		"VA AMIC3", "VA MIC BIAS3",
		"VA AMIC4", "Analog Mic4",
		"VA AMIC4", "VA MIC BIAS3",
		"VA AMIC5", "Analog Mic5",
		"VA AMIC5", "VA MIC BIAS4",
		"TX DMIC0", "Digital Mic0",
		"Digital Mic0", "MIC BIAS3",
		"TX DMIC1", "Digital Mic1",
		"Digital Mic1", "MIC BIAS3",
		"TX DMIC2", "Digital Mic2",
		"Digital Mic2", "MIC BIAS1",
		"TX DMIC3", "Digital Mic3",
		"Digital Mic3", "MIC BIAS1",
		"IN1_HPHL", "HPHL_OUT",
		"IN2_HPHR", "HPHR_OUT",
		"IN3_EAR", "AUX_OUT",
		"HAP_IN", "PCM_OUT",
		"RX_TX DEC0_INP", "TX DEC0 MUX",
		"RX_TX DEC1_INP", "TX DEC1 MUX",
		"RX_TX DEC2_INP", "TX DEC2 MUX",
		"RX_TX DEC3_INP", "TX DEC3 MUX",
		"TX SWR_INPUT", "WCD_TX_OUTPUT",
		"VA SWR_INPUT", "VA_SWR_CLK",
		"VA SWR_INPUT", "WCD_TX_OUTPUT",
		"VA_AIF1 CAP", "VA_SWR_CLK",
		"VA_AIF2 CAP", "VA_SWR_CLK",
		"VA_AIF3 CAP", "VA_SWR_CLK",
		"VA DMIC0", "Digital Mic0",
		"VA DMIC1", "Digital Mic1",
		"VA DMIC2", "Digital Mic2",
		"VA DMIC3", "Digital Mic3",
		"Digital Mic0", "VA MIC BIAS3",
		"Digital Mic1", "VA MIC BIAS3",
		"Digital Mic2", "VA MIC BIAS1",
		"Digital Mic3", "VA MIC BIAS1";
	qcom,ext-disp-audio-rx = <1>;
};

&wcd939x_codec {
	qcom,cdc-vdd-mic-bias-voltage = <3296000 3296000>;
	qcom,usbcss-hs-xtalk-config = <1>;
	qcom,usbcss-hs-rdson-3p6v = <0x186>;
	qcom,usbcss-hs-rdson-6v = <0x154>;
	qcom,usbcss-hs-r1-l = <0x1a3>;
	qcom,usbcss-hs-r1-r = <0x1f0>;
	qcom,usbcss-hs-r3-l = <0x75>;
	qcom,usbcss-hs-r3-r = <0x63>;
	qcom,usbcss-hs-r4-sbu1 = <0x3de>;
	qcom,usbcss-hs-r4-sbu2 = <0x3fc>;
	qcom,usbcss-hs-r6-sbu1 = <0x15>;
	qcom,usbcss-hs-r6-sbu2 = <0x0a>;
	qcom,usbcss-hs-r7-sbu1 = <0x1b>;
	qcom,usbcss-hs-r7-sbu2 = <0x0d>;
	qcom,usbcss-hs-rcom-margin = <0x1f4>;
	qcom,usbcss-hs-diff-slope = <0x26aa>;
	qcom,usbcss-hs-lin-k-aud = <0x0d>;
};